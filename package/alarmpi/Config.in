## package/alarmpi/Config.in
```kconfig
config BR2_PACKAGE_ALARMPI
	bool "alarmpi"
	help
		AlarmPI is an application to handle your home safety system
		see http://github.com/horfee/alarmpi for more information on this software
	select BR2_PACKAGE_LIBEVENT 
	select BR2_PACKAGE_SQLITE
	select BR2_PACKAGE_OPENSSL
if BR2_PACKAGE_ALARMPI
choice
	prompt "Which library to use"
	default BR2_PACKAGE_ALARMPIUSEPIGPIO
	help
	  Select the desired gpio library provider.

config BR2_PACKAGE_ALARMPIUSEWIRINGPI
	bool "Wiring PI"
	select BR2_PACKAGE_WIRINGPI

config BR2_PACKAGE_ALARMPIUSEPIGPIO
	bool "PiGpio"
	select BR2_PACKAGE_PIGPIO
	
endchoice
endif
```

## package/pigpio/Config.in
```kconfig
config BR2_PACKAGE_PIGPIO
	bool "pigpio"
	help
		PIGPIO pigpio is a library for the Raspberry which allows control of the General Purpose Input Outputs (GPIO).  pigpio works on all versions of the PI.
		see http://abyz.co.uk/rpi/pigpio/index.html
```
